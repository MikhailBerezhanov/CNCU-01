

/* Includes ------------------------------------------------------------------*/
#include "lwip/opt.h"
#include "lwip/arch.h"
#include "lwip/api.h"
#include "fs.h"
#include "string.h"
#include "httpserver_netconn.h"
#include "FreeRTOS.h"
#include "task.h"
#include "leds.h"

/* Private typedef -----------------------------------------------------------*/
/* Private define ------------------------------------------------------------*/
#define WEBSERVER_THREAD_PRIO    ( tskIDLE_PRIORITY + 3 )

/* Private macro -------------------------------------------------------------*/
/* Private variables ---------------------------------------------------------*/
u32_t nPageHits = 0;


/* Format of dynamic web page: the page header */
static const unsigned char PAGE_HEADER_200_OK[] = {
  //"HTTP/1.1 200 OK"
  0x48,0x54,0x54,0x50,0x2f,0x31,0x2e,0x30,0x20,0x32,0x30,0x30,0x20,0x4f,0x4b,0x0d,
  0x0a,
  //zero
  0x00
};
static const unsigned char PAGE_HEADER_SERVER[] = {
  //"Server: lwIP/1.3.1 (http://savannah.nongnu.org/projects/lwip)"
  0x53,0x65,0x72,0x76,0x65,0x72,0x3a,0x20,0x6c,0x77,0x49,0x50,0x2f,0x31,0x2e,0x33,
  0x2e,0x31,0x20,0x28,0x68,0x74,0x74,0x70,0x3a,0x2f,0x2f,0x73,0x61,0x76,0x61,0x6e,
  0x6e,0x61,0x68,0x2e,0x6e,0x6f,0x6e,0x67,0x6e,0x75,0x2e,0x6f,0x72,0x67,0x2f,0x70,
  0x72,0x6f,0x6a,0x65,0x63,0x74,0x73,0x2f,0x6c,0x77,0x69,0x70,0x29,0x0d,0x0a,
  //zero
  0x00
};
static const unsigned char PAGE_HEADER_CONTENT_TEXT[] = {
  //"Content-type: text/html"
  0x43,0x6f,0x6e,0x74,0x65,0x6e,0x74,0x2d,0x74,0x79,0x70,0x65,0x3a,0x20,0x74,0x65,
  0x78,0x74,0x2f,0x68,0x74,0x6d,0x6c,0x0d,0x0a,0x0d,0x0a,
  //zero
  0x00
};
//*
static const unsigned char PAGE_HEADER_CONTENT_STREAM[] = {
  //"Content-Type: application/octet-stream"
  0x43,0x6f,0x6e,0x74,0x65,0x6e,0x74,0x2d,0x54,0x79,0x70,0x65,0x3a,0x20,0x61,0x70,
  0x70,0x6c,0x69,0x63,0x61,0x74,0x69,0x6f,0x6e,0x2f,0x6f,0x63,0x74,0x65,0x74,0x2d,
  0x73,0x74,0x72,0x65,0x61,0x6d,0x0d,0x0a,
  //zero
  0x00
};
static const unsigned char PAGE_HEADER_LEN[] = {
  //"Content-Length: "
  0x43,0x6f,0x6e,0x74,0x65,0x6e,0x74,0x2d,0x4c,0x65,0x6e,0x67,0x74,0x68,0x3a,0x20,
  //zero
  0x00
};
static const unsigned char PAGE_HEADER_BYTES[] = {
  //"Accept-Ranges: bytes"
  0x41,0x63,0x63,0x65,0x70,0x74,0x2d,0x52,0x61,0x6e,0x67,0x65,0x73,0x3a,0x20,0x62,
  0x79,0x74,0x65,0x73,0x0d,0x0a,0x0d,0x0a,
  //zero
  0x00
};
static const unsigned char PAGE_START[] = {
0x3c,0x21,0x44,0x4f,0x43,0x54,0x59,0x50,0x45,0x20,0x68,0x74,0x6d,0x6c,0x20,0x50,
0x55,0x42,0x4c,0x49,0x43,0x20,0x22,0x2d,0x2f,0x2f,0x57,0x33,0x43,0x2f,0x2f,0x44,
0x54,0x44,0x20,0x48,0x54,0x4d,0x4c,0x20,0x34,0x2e,0x30,0x31,0x2f,0x2f,0x45,0x4e,
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0x61,0x67,0x65,0x20,0x68,0x69,0x74,0x73,0x3a,0x0d,0x0a,0x00};

/* Private function prototypes -----------------------------------------------*/
/* Private functions ---------------------------------------------------------*/
void DynWebPageStr (struct netconn *conn);
/**
  * @brief serve tcp connection  
  * @param conn: pointer on connection structure 
  * @retval None
  */
void http_server_serve(struct netconn *conn) 
{
  struct netbuf *inbuf;
  char* buf;
  u16_t buflen;
  struct fs_file * file;
	char* path_end = NULL;
  
  /* Read the data from the port, blocking if nothing yet there. 
   We assume the request (the part we care about) is in one netbuf */
  netconn_recv(conn, &inbuf);
  
  if (inbuf != NULL)
  {
    if (netconn_err(conn) == ERR_OK) 
    {
      netbuf_data(inbuf, (void**)&buf, &buflen);
    
			//printf("%s\r\n", buf);
			
      /* Is this an HTTP GET command? (only check the first 5 chars, since
      there are other formats for GET, and we're keeping it very simple )*/
      if ((buflen >=5) && (strncmp(buf, "GET /", 5) == 0))
      {

				// [ HTML pages ]
				if ((strncmp(buf, "GET /cncu_welcome.html", 22) == 0)||(strncmp(buf, "GET / ", 6) == 0))
				{
					file = fs_open("/cncu_welcome.html"); 
          netconn_write(conn, (const unsigned char*)(file->data), (size_t)file->len, NETCONN_NOCOPY);
          fs_close(file);
				}
				else if (strncmp((char const *)buf,"GET /settings?",14)==0)
				{
					file = fs_open("/cncu_settings.html"); 
          netconn_write(conn, (const unsigned char*)(file->data), (size_t)file->len, NETCONN_NOCOPY);
          fs_close(file);
				}
				// Temporary sending login+password via GET request. TODO: Use POST Request
				else if (strncmp((char const *)buf,"GET /?username",14)==0)
				{
					if(strncmp((char const *)buf,"GET /?username=admin&pass=molodec",33)==0)
					{
						file = fs_open("/cncu_mainmenu.html"); 
						netconn_write(conn, (const unsigned char*)(file->data), (size_t)file->len, NETCONN_NOCOPY);
						fs_close(file);
					}
					else
					{
						file = fs_open("/cncu_welcome_err.html"); 
						netconn_write(conn, (const unsigned char*)(file->data), (size_t)file->len, NETCONN_NOCOPY);
						fs_close(file);
					}
				}	
				
				// [ Buttons ]
				else if (strncmp((char const *)buf,"GET /content?",13)==0)
				{
					DynWebPageStr(conn);
				}
				else if (strncmp((char const *)buf,"GET /return?return=mainmenu",27)==0)
				{
					file = fs_open("/cncu_mainmenu.html"); 
					netconn_write(conn, (const unsigned char*)(file->data), (size_t)file->len, NETCONN_NOCOPY);
					fs_close(file);
				}
				
				// [ Files ]
				else if (NULL != (path_end = strstr(&buf[4], " ")))
				{
					char path[40]={0};		
					*path_end = 0;
					strcpy(&path[0], &buf[4]); 
					
					printf("Request:%s\r\n", path);
					
					file = fs_open(path);
					if (file) 
					{
						netconn_write(conn, (const unsigned char*)(file->data), (size_t)file->len, NETCONN_NOCOPY);
						fs_close(file);
					}
					// 404 Load Error page
					else
					{
						fs_close(file);
						file = fs_open("/404.html"); 
						netconn_write(conn, (const unsigned char*)(file->data), (size_t)file->len, NETCONN_NOCOPY);
						fs_close(file);
					}
				}
				else
				{
					file = fs_open("/404.html"); 
					netconn_write(conn, (const unsigned char*)(file->data), (size_t)file->len, NETCONN_NOCOPY);
					fs_close(file);
				}
      }
			else if ((buflen >=5) && (strncmp(buf, "POST /", 6) == 0))
      {
				printf("POST COMMAND\r\n");
			}
    }
  }
  /* Close the connection (server closes in HTTP) */
  netconn_close(conn);
  
  /* Delete the buffer (netconn_recv gives us ownership,
   so we have to make sure to deallocate the buffer) */
  netbuf_delete(inbuf);
}


/**
  * @brief  http server thread 
  * @param arg: pointer on argument(not used here) 
  * @retval None
  */
static void http_server_netconn_thread(void *arg)
{ 
  struct netconn *conn, *newconn;
  err_t err;
  
  /* Create a new TCP connection handle */
  conn = netconn_new(NETCONN_TCP);
  
  if (conn!= NULL)
  {
    /* Bind to port 80 (HTTP) with default IP address */
    err = netconn_bind(conn, NULL, 80);
    
    if (err == ERR_OK)
    {
      /* Put the connection into LISTEN state */
      netconn_listen(conn);
  
      while(1) 
      {
        /* accept any icoming connection */
        netconn_accept(conn, &newconn);
      
        /* serve connection */
        http_server_serve(newconn);
      
        /* delete connection */
        netconn_delete(newconn);
      }
    }
    else
    {
      printf("can not bind netconn");
    }
  }
  else
  {
    printf("can not create netconn");
  }
}

/**
  * @brief  Initialize the HTTP server (start its thread) 
  * @param  none
  * @retval None
  */
void http_server_netconn_init()
{
  sys_thread_new("HTTP", http_server_netconn_thread, NULL, DEFAULT_THREAD_STACKSIZE, WEBSERVER_THREAD_PRIO);
}

/**
  * @brief  Create and send a dynamic Web Page. This page contains the list of 
  *         running tasks and the number of page hits. 
  * @param  conn pointer on connection structure 
  * @retval None
  */
void DynWebPage(struct netconn *conn)
{
  portCHAR PAGE_BODY[512];
  portCHAR pagehits[10] = {0};

  memset(PAGE_BODY, 0,512);

  /* Update the hit count */
  nPageHits++;
  sprintf(pagehits, "%d", nPageHits);
  strcat(PAGE_BODY, pagehits);
  strcat((char *)PAGE_BODY, "<pre><br>Name          State  Priority  Stack   Num" );
  strcat((char *)PAGE_BODY, "<br>---------------------------------------------<br>");
    
  /* The list of tasks and their status */
  vTaskList((/*signed*/ char *)(PAGE_BODY + strlen(PAGE_BODY)));
  strcat((char *)PAGE_BODY, "<br><br>---------------------------------------------");
  strcat((char *)PAGE_BODY, "<br>B : Blocked, R : Ready, D : Deleted, S : Suspended<br>");

  /* Send the dynamically generated page */
  netconn_write(conn, PAGE_START, strlen((char*)PAGE_START), NETCONN_COPY);
  netconn_write(conn, PAGE_BODY, strlen(PAGE_BODY), NETCONN_COPY);
}

void DynWebPageStr (struct netconn *conn)
{
  portCHAR PAGE_BODY[512];
  portCHAR pagehits[10] = {0};
  char JSON[128] = {0};
	
  memset(PAGE_BODY, 0, sizeof(PAGE_BODY));

  /* Update the hit count */
  nPageHits++;
  sprintf(pagehits, "%d", nPageHits);
	sprintf(PAGE_BODY, "%s%s%s", PAGE_HEADER_200_OK, PAGE_HEADER_SERVER, PAGE_HEADER_CONTENT_TEXT);
	
	sprintf(JSON, "{\"water\":%d,\"wind\":%d,\"temp\":%d,\"light\":%d}", nPageHits, nPageHits+10, nPageHits+23, nPageHits+19);
	strcat(PAGE_BODY, JSON);
	
	netconn_write(conn, PAGE_BODY, strlen((char*)PAGE_BODY), NETCONN_COPY);
}

/**
  * @brief  SSI WEB intterface mainmenu.
  * @param  None
  * @retval None
  */
uint16_t SSI_Handler(int iIndex, char *pcInsert, int iInsertLen)
{
  if (iIndex ==0)							// water
  {
    sprintf(pcInsert,"%lu", 70);
		printf("tag 'w'\r\n");
    return strlen(pcInsert);
  }
  else if (iIndex ==1)				// tempreture
  {
    sprintf(pcInsert,"%lu", 25);
		printf("tag 't'\r\n");
    return strlen(pcInsert);
  }
  else if (iIndex ==2)				// humidity
  {
    sprintf(pcInsert,"%lu", 80);
		printf("tag 'h'\r\n");
    return strlen(pcInsert);
  }
  else if (iIndex ==3)				// led state
  {
    sprintf(pcInsert,"%lu", 6);
		printf("tag 'l'\r\n");
    return strlen(pcInsert);
  }
	else if (iIndex ==4)				// wind
  {
    sprintf(pcInsert,"%lu", 50);
		printf("tag 'v'\r\n");
    return strlen(pcInsert);
  }
  return 0;
}















