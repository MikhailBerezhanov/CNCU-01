

/* Includes ------------------------------------------------------------------*/
#include <string.h>
#include "FreeRTOS.h"
#include "fs.h"
#include "task.h"
#include "leds.h"
#include "sdcard.h"
#include "httpserver.h"

#define DEBUG_MSG 1
#include "dbgmsg.h"

/* Private typedef -----------------------------------------------------------*/
/* Private define ------------------------------------------------------------*/

/* Private macro -------------------------------------------------------------*/


/* Private variables ---------------------------------------------------------*/
u32_t nPageHits = 0;
_Bool signed_in = 0;												// Sign in status (false)
extern xSemaphoreHandle USARTDebugMutex;		// for mutual printf
extern osMessageQId SDStatusQid;						// For SD status monitoring

/* Format of dynamic web page: the page header */
static const char PAGE_HEADER_200_OK[] = "HTTP/1.1 200 OK\r\n";

static const char PAGE_HEADER_SERVER[] = "Server: CNCU GrowBox.v2 WebServer\r\n";

static const char PAGE_HEADER_CONTENT_TEXT_HTML[] = "Content-type: text/html\r\n\r\n";

static const char PAGE_HEADER_CONTENT_STREAM[] = "Content-Type: application/octet-stream\r\n";

static const char PAGE_HEADER_LEN[] = "Content-Length: ";

static const char PAGE_HEADER_BYTES[] = "Accept-Ranges: bytes\r\n\r\n";

static const unsigned char PAGE_START[] = {
0x3c,0x21,0x44,0x4f,0x43,0x54,0x59,0x50,0x45,0x20,0x68,0x74,0x6d,0x6c,0x20,0x50,
0x55,0x42,0x4c,0x49,0x43,0x20,0x22,0x2d,0x2f,0x2f,0x57,0x33,0x43,0x2f,0x2f,0x44,
0x54,0x44,0x20,0x48,0x54,0x4d,0x4c,0x20,0x34,0x2e,0x30,0x31,0x2f,0x2f,0x45,0x4e,
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0x61,0x67,0x65,0x20,0x68,0x69,0x74,0x73,0x3a,0x0d,0x0a,0x00};


static const char PAGE_HEADER_CONNECTION[] = "Connection: Close\r\n";

#if !OLD_HTTP
static char file_buf[50*1024];
#else
static char file_buf[1];
#endif

/**
  * @brief  Create and send a dynamic Web Page. This page contains the list of 
  *         running tasks and the number of page hits. 
  * @param  conn pointer on connection structure 
  * @retval None
  */
void DynWebPage(struct netconn *conn)
{
  portCHAR PAGE_BODY[512];
  portCHAR pagehits[10] = {0};

  memset(PAGE_BODY, 0,512);

  /* Update the hit count */
  nPageHits++;
  sprintf(pagehits, "%d", nPageHits);
  strcat(PAGE_BODY, pagehits);
  strcat((char *)PAGE_BODY, "<pre><br>Name          State  Priority  Stack   Num" );
  strcat((char *)PAGE_BODY, "<br>---------------------------------------------<br>");
    
  /* The list of tasks and their status */
  vTaskList((/*signed*/ char *)(PAGE_BODY + strlen(PAGE_BODY)));
  strcat((char *)PAGE_BODY, "<br><br>---------------------------------------------");
  strcat((char *)PAGE_BODY, "<br>B : Blocked, R : Ready, D : Deleted, S : Suspended<br>");

  /* Send the dynamically generated page */
  netconn_write(conn, PAGE_START, strlen((char*)PAGE_START), NETCONN_COPY);
  netconn_write(conn, PAGE_BODY, strlen(PAGE_BODY), NETCONN_COPY);
}




/* Private function prototypes -----------------------------------------------*/
/* Private functions ---------------------------------------------------------*/

static char* http_set_file_type(const char* fname)
{
	char *tmp = strchr(fname, '.');
	
	if (NULL == tmp)
	{
		m_dbgmsg("WARNING: File has no extension!\r\n");
		return "Content-type: \r\n\r\n";
	}
	else if (!strcmp(tmp, ".html")) return "Content-type: text/html\r\n\r\n";  
	else if (!strcmp(tmp, ".css")) return "Content-type: text/css\r\n\r\n";
	else if (!strcmp(tmp, ".ogg")) return "Content-type: text/plain\r\n\r\n";
	else if (!strcmp(tmp, ".jpg")) return "Content-type: img/jpeg\r\n\r\n";
	else if (!strcmp(tmp, ".jpeg")) return "Content-type: img/jpeg\r\n\r\n";
	else if (!strcmp(tmp, ".ico")) return "Content-type: img/x-icon\r\n\r\n";
	else if (!strcmp(tmp, ".png")) return "Content-type: img/png\r\n\r\n";
	else if (!strcmp(tmp, ".gif")) return "Content-type: img/gif\r\n\r\n";
	else 
	{
		m_dbgmsg("WARNING: File has not supported extension!\r\n");
		return "Content-type: text/plain\r\n\r\n";
	}
}

/**
  * @brief  Get requested file from sd card and send by frames
  * @param  None
  * @retval None
  */
static _Bool http_put_file(struct netconn *conn, const char* fname)
{
#if !OLD_HTTP
	char PAGE_BODY[512];
	char content_length[12];
	char content_length_ending[2] = {0x0d,0x0a};
	uint32_t fsize = 0;
	FRESULT res = FR_OK;
	
	if (sd_f_get_size(fname, &fsize) != FR_OK)
	{
		// Hardware Error occured
		if (res == FR_DISK_ERR)
		{
			m_errmsg("SD: Hardware Error\r\n");
			NVIC_SystemReset();
		}
	}
	m_dbgmsg("File size: %d\r\n", fsize);
	
	if(!fsize)
	{
		m_dbgmsg("WARNING: File not found\r\n");
		return 0;  
	}
	
	memset(content_length, 0, sizeof(content_length));
	memset(PAGE_BODY, 0, sizeof(PAGE_BODY));
	memset(file_buf, 0, sizeof(file_buf));
	
	sprintf(content_length, "%d", fsize);
	strcat(content_length, content_length_ending);
	sprintf(PAGE_BODY, "%s%s%s", PAGE_HEADER_200_OK, PAGE_HEADER_SERVER, PAGE_HEADER_LEN);
	strcat(PAGE_BODY, content_length);
	strcat(PAGE_BODY, PAGE_HEADER_CONNECTION);
	strcat(PAGE_BODY, http_set_file_type(fname));
	
	netconn_write(conn, PAGE_BODY, strlen((char*)PAGE_BODY), NETCONN_COPY);
	
	m_dbgmsg("<-Response\r\n%s", PAGE_BODY);
	
	int qres = FR_OK;
	uint32_t bytes_read = 0;
#if 0	
	while(qres != EOF)
	{
		memset(file_buf, 0, sizeof(file_buf));
		qres = sd_f_seq_read(fname, file_buf, sizeof(file_buf), &bytes_read);
		if ((qres != FR_OK) && (qres != EOF)) 
		{
			m_errmsg("Error seq_read file\r\n");
			break;
		}
    else 
		{
			m_dbgmsg("Bytes read: %d\r\n", bytes_read);
			//m_dbgmsg("%s", file_buf);
			netconn_write(conn, file_buf, bytes_read, NETCONN_NOCOPY);
			//osDelay(30);	// giving time to send data
		}
	}
	if(qres == EOF) 
	{
		//m_dbgmsg("%s\r\n", file_buf);
		//netconn_write(conn, file_buf, fsize, NETCONN_NOCOPY);
		m_dbgmsg("Success seq_read file\r\n");
		return 1;
	}
#else		
	if (!sd_f_read_(fname, file_buf, sizeof(file_buf), F_AUTOCLOSE_ON))
	{
		//m_dbgmsg("%s", file_buf);
		netconn_write(conn, file_buf, fsize, NETCONN_NOCOPY);	
		return 1;
	}
#endif
#else
	struct fs_file * file;
	
	file = fs_open(fname);
	if (file) 
	{
		netconn_write(conn, (const unsigned char*)(file->data), (size_t)file->len, NETCONN_NOCOPY);
		fs_close(file);
		return 1;
	}
	else
	{
		m_dbgmsg("WARNING: File not found\r\n");
	}
#endif	
	
	return 0;
}

/**
  * @brief  Create and send a dynamic Web Page. This page sends JSON formatted
						data from external sensors. 
  * @param  conn pointer on connection structure 
  * @retval None
  */
static void http_show_sensors (struct netconn *conn)
{
  portCHAR PAGE_BODY[512];
  portCHAR pagehits[10] = {0};
  char JSON[128] = {0};
	
  memset(PAGE_BODY, 0, sizeof(PAGE_BODY));

  /* Update the hit count */
  nPageHits++;
  sprintf(pagehits, "%d", nPageHits);
	sprintf(PAGE_BODY, "%s%s%s", PAGE_HEADER_200_OK, PAGE_HEADER_SERVER, PAGE_HEADER_CONTENT_TEXT_HTML);
	
	sprintf(JSON, "{\"water\":%d,\"wind\":%d,\"temp\":%d,\"light\":%d}", nPageHits, nPageHits+10, nPageHits+23, nPageHits+19);
	strcat(PAGE_BODY, JSON);
	
	netconn_write(conn, PAGE_BODY, strlen((char*)PAGE_BODY), NETCONN_NOCOPY);
}

static _Bool user_sign_in(char *buf, char *log, char *pass)
{
	char *log_ptr = NULL;
	char *pass_ptr = NULL;
	
	m_dbgmsg("User Sign in.\r\n");
	
	if (NULL != (log_ptr = strstr(buf, "username=")))
	{
		if (NULL != (pass_ptr = strstr(log_ptr, "&pass=")))
		{	
			*pass_ptr = '\0';		// now we have 'login' as c-string
			
			m_dbgmsg("Login: %s, Password: %s\r\n", &log_ptr[9], &pass_ptr[6]);
			
			if (!strcmp(&log_ptr[9], log) && !strcmp(&pass_ptr[6], pass))
			{
				m_dbgmsg("(+) Success\r\n");
				signed_in = 1;
				return 1;
			}
			else m_dbgmsg("(-) Failure\r\n"); 				
			
		}	
	}
	return 0;
}


/**
  * @brief serve tcp connection  
  * @param conn: pointer on connection structure 
  * @retval None
  */
void http_server_serve(struct netconn *conn) 
{
  struct netbuf *inbuf;
  char* buf;
  u16_t buflen;
	char* path_end = NULL;
	char path[40]={0};			
  
  /* Read the data from the port, blocking if nothing yet there. 
   We assume the request (the part we care about) is in one netbuf 
	Timeout for recveive to avoid thread blocking     */
	netconn_set_recvtimeout(conn, 700);
	
  if (netconn_recv(conn, &inbuf) == ERR_TIMEOUT)
	{
		netconn_close(conn);
		netbuf_delete(inbuf);
		m_dbgmsg("netconn_recv timed out\r\n");
		return;
	}		
	m_dbgmsg("netconn_recv done \r\n");
	
  if (inbuf != NULL)
  {
    if (netconn_err(conn) == ERR_OK) 
    {
      netbuf_data(inbuf, (void**)&buf, &buflen);
			
			//m_dbgmsg("%s\r\n", buf);
			
      /* Is this an HTTP GET command? (only check the first 5 chars, since
      there are other formats for GET, and we're keeping it very simple )*/
      if ((buflen >=5) && (strncmp(buf, "GET /", 5) == 0))
      {
				// Which file client wants?  	
				path_end = strstr(&buf[4], " ");
				if (NULL != path_end)
				{
					*path_end = 0;
					strcpy(&path[0], &buf[4]);
					*path_end = ' ';
					m_dbgmsg("->Request:%s\r\n", path);
				}
				else 
				{
					m_errmsg("Incorrect GET format\r\n");
					return;
				}					
				
				// [ HTML pages ]
				if ((strncmp(buf, "GET /cncu_welcome.html", 22) == 0)||(strncmp(buf, "GET / ", 6) == 0))
				{
					http_put_file(conn, "/cncu_welcome.html");
				}
				else if (strncmp((char const *)buf,"GET /settings?",14)==0)
				{
					http_put_file(conn, "/cncu_settings.html");
				}
				// Temporary sending login+password via GET request. TODO: Use POST Request
				else if (strncmp((char const *)buf,"GET /?username",14)==0)
				{
					if(strncmp((char const *)buf,"GET /?username=admin&pass=molodec",33)==0)
					{
						http_put_file(conn, "/cncu_mainmenu.html");
					}
					else
					{
						http_put_file(conn, "/cncu_welcome_err.html");
					}
				}	
				
				// [ Buttons ]
				else if (strncmp((char const *)buf,"GET /content?",13)==0)
				{
					http_show_sensors(conn);
				}
				else if (strncmp((char const *)buf,"GET /return?return=mainmenu",27)==0)
				{
					http_put_file(conn, "/cncu_mainmenu.html");
				}
				
				// [ Files ]
				else if (NULL != path_end)
				{				
					if (!http_put_file(conn, path))
					// 404 Load Error page
					{
						m_errmsg("Sending 404\r\n");
						http_put_file(conn, "/404.html");
					}
				}
				// TODO: put 404 when no PAGE found but no FILE
				else
				{
					http_put_file(conn, "/404.html");
				}
      }
			else if ((buflen >=5) && (strncmp(buf, "POST /", 6) == 0))
      {
				// TODO: Parse POST method to get data
				m_dbgmsg("POST COMMAND datalen: %d\r\n", buflen);			
				m_dbgmsg("%s\r\n", buf);

				if (user_sign_in(buf, "admin", "molodec")) 
					http_put_file(conn, "/cncu_mainmenu.html");
				else 
					http_put_file(conn, "/cncu_welcome_err.html"); 

				// start timer for keep-signed-in flag	
			}
    }
  }
  /* Close the connection (server closes in HTTP) */
  netconn_close(conn);
  
  /* Delete the buffer (netconn_recv gives us ownership,
   so we have to make sure to deallocate the buffer) */
  netbuf_delete(inbuf);
}


